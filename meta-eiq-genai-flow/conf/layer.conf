## meta-eiq-genai-flow/conf/layer.conf
```bitbake
# We have a conf and classes directory, add to BBPATH
BBPATH .= ":${LAYERDIR}"

# We have recipes-* directories, add to BBFILES
BBFILES += "${LAYERDIR}/recipes-*/*/*.bb \
            ${LAYERDIR}/recipes-*/*/*.bbappend"

BBFILE_COLLECTIONS += "meta-eiq-genai-flow"
BBFILE_PATTERN_meta-eiq-genai-flow = "^${LAYERDIR}/"
BBFILE_PRIORITY_meta-eiq-genai-flow = "9"

LAYERDEPENDS_meta-eiq-genai-flow = "core"
LAYERSERIES_COMPAT_meta-eiq-genai-flow = " styhead "

PREFERRED_VERSION_onnxruntime = "1.20.1"

BBMASK += "meta-imx/meta-imx-ml/recipes-libraries/onnxruntime/onnxruntime_1.17.1.bb"
```
